/*
 * Copyright (c) 2023 Nordic Semiconductor ASA
 * SPDX-License-Identifier: LicenseRef-Nordic-5-Clause
 */

.param_1 = {0.0, 0.005, 0.01, 0.015, 0.02, 0.025, 0.03, 0.035, 0.04, 0.045, 0.05, 0.055, 0.06, 0.065, 0.07, 0.075, 0.08, 0.085, 0.09, 0.095, 0.1, 0.105, 0.11, 0.115, 0.12, 0.125, 0.13, 0.135, 0.14, 0.145, 0.15, 0.155, 0.16, 0.165, 0.17, 0.17500000000000002, 0.18, 0.185, 0.19, 0.195, 0.2, 0.20500000000000002, 0.21, 0.215, 0.22, 0.225, 0.23, 0.23500000000000001, 0.24, 0.245, 0.25, 0.255, 0.26, 0.265, 0.27, 0.275, 0.28, 0.28500000000000003, 0.29, 0.295, 0.3, 0.305, 0.31, 0.315, 0.32, 0.325, 0.33, 0.335, 0.34, 0.34500000000000003, 0.35000000000000003, 0.355, 0.36, 0.365, 0.37, 0.375, 0.38, 0.385, 0.39, 0.395, 0.4, 0.405, 0.41000000000000003, 0.41500000000000004, 0.42, 0.425, 0.43, 0.435, 0.44, 0.445, 0.45, 0.455, 0.46, 0.465, 0.47000000000000003, 0.47500000000000003, 0.48, 0.485, 0.49, 0.495, 0.5, 0.505, 0.51, 0.515, 0.52, 0.525, 0.53, 0.535, 0.54, 0.545, 0.55, 0.555, 0.56, 0.5650000000000001, 0.5700000000000001, 0.5750000000000001, 0.58, 0.585, 0.59, 0.595, 0.6, 0.605, 0.61, 0.615, 0.62, 0.625, 0.63, 0.635, 0.64, 0.645, 0.65, 0.655, 0.66, 0.665, 0.67, 0.675, 0.68, 0.685, 0.6900000000000001, 0.6950000000000001, 0.7000000000000001, 0.705, 0.71, 0.715, 0.72, 0.725, 0.73, 0.735, 0.74, 0.745, 0.75, 0.755, 0.76, 0.765, 0.77, 0.775, 0.78, 0.785, 0.79, 0.795, 0.8, 0.805, 0.81, 0.8150000000000001, 0.8200000000000001, 0.8250000000000001, 0.8300000000000001, 0.835, 0.84, 0.845, 0.85, 0.855, 0.86, 0.865, 0.87, 0.875, 0.88, 0.885, 0.89, 0.895, 0.9, 0.905, 0.91, 0.915, 0.92, 0.925, 0.93, 0.935, 0.9400000000000001, 0.9450000000000001, 0.9500000000000001, 0.9550000000000001, 0.96, 0.965, 0.97, 0.975, 0.98, 0.985, 0.99, 0.995, 1.0},
.temps = {25.0},
.param_2 = {2.99, 3.001652892561984, 3.013305785123967, 3.0249586776859507, 3.036611570247934, 3.0482644628099176, 3.0599173553719012, 3.0715702479338844, 3.083223140495868, 3.0948760330578513, 3.106528925619835, 3.118181818181818, 3.129834710743802, 3.1414876033057855, 3.1531404958677687, 3.1647933884297523, 3.176446280991736, 3.188099173553719, 3.199752066115703, 3.211404958677686, 3.2230578512396697, 3.234710743801653, 3.2463636363636366, 3.25801652892562, 3.2696694214876034, 3.281322314049587, 3.2929752066115707, 3.304628099173554, 3.3162809917355376, 3.327933884297521, 3.3395867768595044, 3.3512396694214877, 3.3628925619834713, 3.374545454545455, 3.386198347107438, 3.397851239669422, 3.409504132231405, 3.4211570247933887, 3.432809917355372, 3.4444628099173555, 3.456115702479339, 3.4677685950413224, 3.479421487603306, 3.4910743801652897, 3.502727272727273, 3.5143801652892566, 3.5260330578512398, 3.5376859504132234, 3.5493388429752066, 3.5609917355371903, 3.572644628099174, 3.584297520661157, 3.595950413223141, 3.6076033057851244, 3.6192561983471077, 3.6309090909090913, 3.6425619834710745, 3.654214876033058, 3.6658677685950414, 3.677520661157025, 3.6891735537190087, 3.700826446280992, 3.7124793388429755, 3.724132231404959, 3.7357851239669424, 3.7474380165289256, 3.7590909090909093, 3.770743801652893, 3.782396694214876, 3.7940495867768598, 3.8057024793388434, 3.8173553719008266, 3.8290082644628103, 3.8406611570247935, 3.852314049586777, 3.8639669421487604, 3.875619834710744, 3.8872727272727277, 3.898925619834711, 3.9105785123966945, 3.922231404958678, 3.9338842975206614, 3.945537190082645, 3.9571900826446282, 3.968842975206612, 3.980495867768595, 3.9921487603305787, 4.003801652892562, 4.015454545454546, 4.027107438016529, 4.038760330578513, 4.050413223140496, 4.062066115702479, 4.073719008264463, 4.085371900826447, 4.09702479338843, 4.108677685950413, 4.120330578512397, 4.13198347107438, 4.1436363636363645, 4.155289256198348, 4.166942148760331, 4.178595041322314, 4.190247933884297, 4.201900826446281, 4.213553719008265, 4.225206611570249, 4.236859504132232, 4.248512396694215, 4.260165289256198, 4.271818181818182, 4.283471074380166, 4.295123966942149, 4.306776859504133, 4.318429752066116, 4.330082644628099, 4.3417355371900825, 4.353388429752067, 4.36504132231405, 4.376694214876033, 4.388347107438017, 4.4},
.param_3 = {0.0996763265943679, 0.11721460088523349, 0.12659718894009492, 0.13037442841683652, 0.13109665697334283, 0.13126974969341235, 0.13196329008618898, 0.1326072166680717, 0.13314777464727687, 0.13375860640190781, 0.13435993882977113, 0.1348878353584651, 0.13536183644023833, 0.1358122254670471, 0.13626671772135518, 0.1367344273653395, 0.1371949178517077, 0.1376005777894977, 0.13797147120948944, 0.13835222017336588, 0.13873558449272988, 0.1391161719703609, 0.13950441300967845, 0.13988025394227793, 0.14022233473648585, 0.14057484231443126, 0.14096004967441614, 0.14134677390424988, 0.14172641331265415, 0.14210659849639748, 0.14249170527198288, 0.1428754152765719, 0.14323730509001317, 0.14357224481701233, 0.14388624036761952, 0.14418577150964365, 0.14447739061642134, 0.14476746718388214, 0.14505932738969438, 0.14535378703868224, 0.1456515863351232, 0.14595261056405315, 0.14625416344455067, 0.14655306332752488, 0.146845209316558, 0.14711655672055213, 0.14734698130561097, 0.14751643902960987, 0.14762031512873672, 0.14768166064935426, 0.14772640615655466, 0.14777693108546602, 0.1478347328355947, 0.14789370089162354, 0.14794811966132368, 0.14800334252708652, 0.14807684958130807, 0.1481867375445845, 0.14834212436784727, 0.14852183305848776, 0.1486983037709769, 0.14884634512273792, 0.14897008306183077, 0.14909344100492528, 0.1492406066707364, 0.14942165588379974, 0.14961865586163564, 0.14981037028664962, 0.1499788129091978, 0.15012756486338408, 0.1502689911379221, 0.15041520633946223, 0.15056905578000454, 0.15072212739684362, 0.15086533076058295, 0.1509936890040033, 0.15111781692837672, 0.15125202279890798, 0.15140934978901993, 0.1515846417307244, 0.15175909687034392, 0.15191362817545387, 0.15203854366634295, 0.15214500935526684, 0.15224699748913195, 0.1523566558490609, 0.1524724173662395, 0.15258647640354958, 0.1526911475214882, 0.15278506651033888, 0.1528753361058649, 0.15296965135075882, 0.15307393881353695, 0.1531866377563957, 0.15330420629325106, 0.1534231129631304, 0.15353999985176744, 0.1536516521206514, 0.15375486693358056, 0.15384902861102256, 0.15393984863892518, 0.15403398778579777, 0.154137322198461, 0.15424912804048652, 0.15436537792320695, 0.15448204860731993, 0.15459663104362908, 0.1547088494644208, 0.15481860751013962, 0.15492644364311772, 0.15503589115773567, 0.15515136566146817, 0.15527696320810971, 0.15541059584468672, 0.15554457860138363, 0.1556710303917067, 0.15578581690490328, 0.1558949922952713, 0.15600632614876886, 0.15612686041029314, 0.15625669376428622, 0.15639207364759483, 0.1565292141516087, 0.15666485576936448, 0.15679659349966496, 0.15692210054928346, 0.1570397690411022, 0.15715177960733734, 0.15726155634624048, 0.1573726212787566, 0.157490721981148, 0.1576238261533776, 0.15777999546218952, 0.1579640798285418, 0.1581712606412388, 0.15839490729155095, 0.1586292248550037, 0.1588773801525238, 0.15914798317457018, 0.15944962107584004, 0.15978184913104818, 0.16012810260392496, 0.1604701487285326, 0.1607924465069372, 0.1610951390015185, 0.16138403436994828, 0.16166459580638387, 0.1619328600600254, 0.16217464304269955, 0.1623752502557984, 0.16252768445820528, 0.16265062080841058, 0.16276808019131758, 0.16290278029974306, 0.16306158837710796, 0.16324080263666405, 0.1634365176871849, 0.1636434085675424, 0.1638533704644432, 0.1640579759669926, 0.16425047093463613, 0.1644350092739485, 0.16462011634321028, 0.16481412894267974, 0.16501890089707613, 0.1652285481514453, 0.16543673299485742, 0.16563866589043752, 0.1658353022117304, 0.1660289295994761, 0.16622183569441495, 0.16641630813728717, 0.16661463456883277, 0.16681909452293364, 0.16703061998678131, 0.16724730093545795, 0.16746686707441183, 0.16768704810909119, 0.167905573744944, 0.16812017368741863, 0.16832862762700368, 0.16853050172420014, 0.16872759603749565, 0.16892185149967426, 0.1691152090435196, 0.16930960960181554, 0.16950699410734577, 0.16970920549386248, 0.1699166838948171, 0.17012882117466827, 0.1703449839969944, 0.17056453902537402, 0.17078685292338566, 0.17101129235460782, 0.17123722398261895, 0.17146401447099768, 0.1716910304833224, 0.17191763868317161, 0.17214320573412392, 0.17236709829975774, 0.17258868304365158},
.param_4 = {0.003987053063774717, 0.00468858403540934, 0.005063887557603798, 0.0052149771366734625, 0.005243866278933714, 0.005250789987736495, 0.0052785316034475605, 0.005304288666722869, 0.005325910985891076, 0.005350344256076314, 0.005374397553190846, 0.005395513414338605, 0.005414473457609535, 0.0054324890186818854, 0.005450668708854208, 0.005469377094613581, 0.005487796714068309, 0.005504023111579909, 0.005518858848379578, 0.005534088806934637, 0.005549423379709197, 0.005564646878814438, 0.005580176520387139, 0.005595210157691119, 0.005608893389459435, 0.005622993692577251, 0.005638401986976647, 0.0056538709561699966, 0.005669056532506167, 0.0056842639398559, 0.0056996682108793155, 0.005715016611062877, 0.005729492203600527, 0.005742889792680495, 0.005755449614704782, 0.005767430860385747, 0.005779095624656855, 0.005790698687355288, 0.005802373095587776, 0.005814151481547291, 0.005826063453404929, 0.005838104422562127, 0.005850166537782028, 0.0058621225331009965, 0.005873808372662321, 0.005884662268822086, 0.00589387925222444, 0.005900657561184396, 0.00590481260514947, 0.005907266425974172, 0.005909056246262188, 0.005911077243418643, 0.005913389313423789, 0.0059157480356649425, 0.0059179247864529485, 0.005920133701083462, 0.005923073983252323, 0.005927469501783381, 0.005933684974713892, 0.005940873322339512, 0.005947932150839078, 0.005953853804909519, 0.005958803322473232, 0.005963737640197013, 0.005969624266829458, 0.005976866235351991, 0.005984746234465426, 0.005992414811465986, 0.005999152516367913, 0.006005102594535364, 0.006010759645516886, 0.006016608253578491, 0.006022762231200183, 0.006028885095873746, 0.006034613230423319, 0.006039747560160133, 0.00604471267713507, 0.006050080911956321, 0.006056373991560799, 0.006063385669228977, 0.006070363874813758, 0.006076545127018156, 0.006081541746653719, 0.006085800374210674, 0.006089879899565279, 0.006094266233962437, 0.006098896694649582, 0.006103459056141985, 0.006107645900859529, 0.0061114026604135565, 0.006115013444234598, 0.006118786054030353, 0.00612295755254148, 0.006127465510255829, 0.006132168251730044, 0.006136924518525218, 0.006141599994070699, 0.006146066084826058, 0.0061501946773432235, 0.006153961144440903, 0.006157593945557008, 0.0061613595114319115, 0.006165492887938441, 0.006169965121619462, 0.006174615116928279, 0.0061792819442927985, 0.006183865241745165, 0.006188353978576833, 0.006192744300405586, 0.00619705774572471, 0.006201435646309428, 0.0062060546264587286, 0.0062110785283243895, 0.006216423833787471, 0.0062217831440553465, 0.00622684121566827, 0.006231432676196132, 0.006235799691810853, 0.006240253045950756, 0.006245074416411727, 0.006250267750571451, 0.006255682945903795, 0.006261168566064348, 0.00626659423077458, 0.006271863739986599, 0.00627688402197134, 0.006281590761644089, 0.006286071184293494, 0.006290462253849619, 0.0062949048511502645, 0.0062996288792459216, 0.006304953046135106, 0.0063111998184875815, 0.006318563193141673, 0.006326850425649553, 0.006335796291662039, 0.006345168994200149, 0.006355095206100954, 0.006365919326982809, 0.006377984843033604, 0.006391273965241928, 0.006405124104157, 0.006418805949141305, 0.006431697860277489, 0.006443805560060742, 0.006455361374797933, 0.006466583832255356, 0.0064773144024010175, 0.006486985721707983, 0.0064950100102319375, 0.006501107378328212, 0.006506024832336425, 0.006510723207652704, 0.006516111211989724, 0.00652246353508432, 0.006529632105466563, 0.006537460707487398, 0.006545736342701697, 0.0065541348185777296, 0.006562319038679705, 0.006570018837385447, 0.00657740037095794, 0.006584804653728412, 0.006592565157707191, 0.006600756035883047, 0.006609141926057814, 0.006617469319794298, 0.006625546635617502, 0.006633412088469216, 0.0066411571839790455, 0.006648873427776599, 0.006656652325491489, 0.006664585382753312, 0.006672763780917347, 0.006681224799471254, 0.0066898920374183195, 0.006698674682976475, 0.0067074819243636485, 0.006716222949797761, 0.006724806947496747, 0.006733145105080149, 0.006741220068968007, 0.0067491038414998275, 0.0067568740599869715, 0.006764608361740785, 0.006772384384072623, 0.006780279764293832, 0.0067883682197545005, 0.006796667355792685, 0.006805152846986732, 0.006813799359879778, 0.006822581561014962, 0.006831474116935428, 0.006840451694184314, 0.00684948895930476, 0.006858560578839908, 0.006867641219332897, 0.006876705547326866, 0.006885728229364958, 0.006894683931990311, 0.006903547321746064},
.param_5 = {0.14030619432692462, 0.10768344938290805, 0.05263931012641221, 0.017997872132991585, 0.0035812851063032197, 0.0034665324513846914, 0.005349867898637398, 0.00473793824435154, 0.004605558935344509, 0.004848656729977002, 0.004516915826229158, 0.0040075904418688905, 0.0036975604343280136, 0.0036195251244672787, 0.0036888075931695505, 0.0037128005214101707, 0.0034646016966327804, 0.0031062134311268808, 0.0030065695354727917, 0.003056453132961861, 0.0030558071879801564, 0.003075314067794207, 0.0030563278876680373, 0.0028716869072296577, 0.0027783534886132756, 0.0029508597517211195, 0.003087726359274519, 0.0030654545529520613, 0.003039298368590331, 0.0030611678373148286, 0.003075267120697736, 0.002982399272121166, 0.0027873181617617954, 0.002595741110425487, 0.0024541067705251447, 0.0023646009952072583, 0.0023267826969541015, 0.0023277470930921362, 0.0023452794192003155, 0.0023690357817153333, 0.0023952941014836193, 0.0024103084377098336, 0.0024018110538869507, 0.0023641834880292964, 0.0022539735721089325, 0.0020070879562119823, 0.0015995292362310128, 0.0010933352925029775, 0.0006608864789776209, 0.00042436411127177304, 0.0003810817444470545, 0.0004333067161601395, 0.00046707922462998347, 0.0004535473029159201, 0.00043856654185197436, 0.0005149196799374839, 0.0007335800699918502, 0.0010610991461568534, 0.0013403820556131228, 0.0014247176125185834, 0.0012980482570006634, 0.0010871171634153909, 0.0009883835287494147, 0.0010820944356225957, 0.0013128595154978523, 0.0015121967635968632, 0.001554857611399483, 0.0014406281902486391, 0.0012687783069377512, 0.001160712914897305, 0.0011505659043127558, 0.001200258568329754, 0.0012276842295254678, 0.0011850999223135539, 0.0010862464286387485, 0.0010099446711751316, 0.001033335179618719, 0.0011661314425728993, 0.0013304757272656481, 0.0013989883252959329, 0.0013159457789178527, 0.0011177871839960704, 0.0009255247192518738, 0.0008338152911560245, 0.0008465859751762873, 0.0009016795084302795, 0.0009192822179547415, 0.0008749206209947291, 0.0007943604271571855, 0.0007367543375068342, 0.0007383393616796838, 0.0007944108306881872, 0.0008679456225475952, 0.0009210699188564632, 0.0009459008269388502, 0.0009431742340654942, 0.0009141566300840259, 0.0008594683272524287, 0.0007895059614845129, 0.0007399268213784463, 0.0007398366991008369, 0.0007898942381433412, 0.0008605610187550732, 0.0009122228989837805, 0.0009316822673336236, 0.0009250124816885703, 0.0009072034284034539, 0.000887905866042097, 0.0008703767147877003, 0.0008691345903841935, 0.0008996880734018532, 0.0009642882014961746, 0.0010369207328742372, 0.0010704615730956941, 0.0010417381880799097, 0.0009649532140785892, 0.000895847614258271, 0.0008820369754623282, 0.0009274724600874182, 0.0010014704620695154, 0.001060852949206787, 0.0010900815492897488, 0.0010911284870785548, 0.0010695173922250535, 0.0010289791196759282, 0.000972702165749021, 0.000918716232215476, 0.0008871492205530379, 0.0008833666856770082, 0.0009166625396302142, 0.0010048194984841122, 0.0011570939241659951, 0.0013610147006567347, 0.0015650607161971607, 0.0017233098520365656, 0.0018318568550596166, 0.0019298914438915273, 0.002075033278265987, 0.0022889636932649747, 0.002535463825911917, 0.0027139261123396152, 0.002753198389937681, 0.002657375612048936, 0.002499961091943694, 0.002366351452044377, 0.002277827219461428, 0.002195302760308465, 0.0020401889452626755, 0.0017695607830920008, 0.0014121656620229295, 0.001101482210448708, 0.0009615829324491169, 0.0010086379653299546, 0.001174032743161621, 0.0013520893476838894, 0.0014997172403078025, 0.001610423723513374, 0.0016674111090331754, 0.0016582695978008093, 0.00158840188077174, 0.001508133227823543, 0.0014785816342965247, 0.001516478674925062, 0.0015951382154634486, 0.0016576768350622627, 0.0016713283911251077, 0.001640470955968816, 0.0015942768674918548, 0.0015610548361543776, 0.0015461339307383005, 0.0015495141512443175, 0.001571195497671301, 0.001611145542585856, 0.0016639416717941988, 0.0017128256500972307, 0.0017449883505220483, 0.001758988694532896, 0.0017548266821286462, 0.0017325023133098194, 0.0016922155282387587, 0.0016413121471259978, 0.0015958736419678654, 0.0015653991018964829, 0.001550452024095747, 0.0015510324085651374, 0.0015671402553047407, 0.001598383568187766, 0.0016387591498853021, 0.0016784627232231154, 0.0017132004087092208, 0.0017428714028230527, 0.0017674757055650449, 0.0017870133169351973, 0.001801484236933163, 0.0018108884655593759, 0.0018152260028137489, 0.0018144968486957617, 0.0018087010032061084, 0.0017978384663445285, 0.0017819092381105885, 0.0017726779511506585},
.param_6 = {3.5076548581731175, 2.692086234572702, 1.3159827531603039, 0.4499468033247911, 0.08953212765758223, 0.08666331128461546, 0.13374669746593626, 0.1184484561087884, 0.11513897338361057, 0.12121641824942575, 0.11292289565572877, 0.10018976104672062, 0.09243901085820017, 0.09048812811168483, 0.09222018982923963, 0.09282001303525245, 0.08661504241581908, 0.0776553357781734, 0.0751642383868184, 0.07641132832404418, 0.07639517969950382, 0.07688285169485665, 0.07640819719170189, 0.07179217268074023, 0.06945883721533319, 0.07377149379302894, 0.07719315898186141, 0.07663636382380101, 0.0759824592147601, 0.07652919593287288, 0.07688167801744306, 0.07455998180302958, 0.06968295404404246, 0.0648935277606344, 0.061352669263131654, 0.0591150248801825, 0.058169567423849156, 0.058193677327303406, 0.05863198548000936, 0.05922589454288307, 0.05988235253709118, 0.06025771094274601, 0.06004527634717316, 0.05910458720073397, 0.05634933930272479, 0.05017719890529626, 0.03998823090577419, 0.027333382312574872, 0.016522161974438787, 0.0106091027817945, 0.009527043611176622, 0.010832667904003834, 0.011676980615751842, 0.011338682572897829, 0.010964163546298145, 0.012872991998438832, 0.018339501749797815, 0.026527478653920467, 0.033509551390326076, 0.035617940312962504, 0.03245120642501598, 0.027177929085386854, 0.024709588218735368, 0.027052360890564286, 0.032821487887446654, 0.03780491908992323, 0.03887144028498768, 0.03601570475621485, 0.03171945767344586, 0.02901782287243193, 0.028764147607815427, 0.030006464208243155, 0.030692105738139297, 0.02962749805784093, 0.027156160715968714, 0.02524861677937751, 0.025833379490466934, 0.02915328606432066, 0.033261893181640856, 0.03497470813239867, 0.03289864447294788, 0.02794467959990332, 0.02313811798129728, 0.020845382278900093, 0.021164649379407097, 0.022541987710755773, 0.02298205544886689, 0.02187301552487031, 0.01985901067892981, 0.018418858437668773, 0.01845848404199435, 0.0198602707672052, 0.021698640563688754, 0.0230267479714108, 0.02364752067346987, 0.023579355851638395, 0.022853915752099607, 0.02148670818131193, 0.019737649037115945, 0.018498170534461678, 0.018495917477520663, 0.019747355953581014, 0.021514025468874487, 0.022805572474596247, 0.02329205668334111, 0.02312531204221313, 0.022680085710086173, 0.022197646651053726, 0.021759417869693376, 0.02172836475960449, 0.022492201835044856, 0.02410720503740471, 0.025923018321855062, 0.026761539327391226, 0.02604345470199887, 0.024123830351965858, 0.0223961903564579, 0.022050924386557424, 0.023186811502184934, 0.025036761551736064, 0.026521323730169244, 0.027252038732247796, 0.02727821217696491, 0.02673793480562625, 0.02572447799189803, 0.02431755414372405, 0.022967905805387767, 0.022178730513827682, 0.022084167141925293, 0.022916563490751884, 0.025120487462101937, 0.028927348104151873, 0.034025367516418714, 0.039126517904927716, 0.04308274630091535, 0.04579642137648998, 0.04824728609728601, 0.05187583195664924, 0.057224092331623067, 0.06338659564779914, 0.06784815280849177, 0.06882995974844264, 0.06643439030122322, 0.06249902729859036, 0.05915878630110838, 0.056945680486536476, 0.05488256900771371, 0.051004723631567495, 0.04423901957729959, 0.03530414155057393, 0.027537055261217525, 0.024039573311229745, 0.02521594913324765, 0.029350818579038096, 0.03380223369209845, 0.03749293100769324, 0.040260593087834695, 0.04168527772583086, 0.04145673994501997, 0.03971004701929237, 0.0377033306955904, 0.03696454085741485, 0.037911966873124814, 0.03987845538658552, 0.04144192087655596, 0.041783209778128994, 0.041011773899221615, 0.03985692168729793, 0.039026370903857965, 0.038653348268455345, 0.038737853781106724, 0.03927988744178157, 0.04027863856464753, 0.04159854179485445, 0.04282064125243068, 0.04362470876305147, 0.0439747173633237, 0.04387066705321685, 0.04331255783274479, 0.042305388205968186, 0.041032803678150986, 0.03989684104919733, 0.039134977547411465, 0.03876130060239402, 0.03877581021412835, 0.03917850638261722, 0.03995958920469389, 0.0409689787471329, 0.04196156808057849, 0.04283001021773147, 0.0435717850705758, 0.04418689263912534, 0.04467533292338011, 0.04503710592332899, 0.04527221163898587, 0.045380650070345196, 0.04536242121739309, 0.045217525080151755, 0.044945961658612865, 0.04454773095276532, 0.04431694877876646},
.param_7 = {0.00024638062091139834, 0.00025628466234776237, 0.0002661887037841262, 0.0002760927452204902, 0.00028599678665685386, 0.0002959008280932179, 0.0003058048695295819, 0.00031570891096594563, 0.00032561295240230966, 0.0003355169938386733, 0.0003454210352750374, 0.00035532507671140104, 0.00036522911814776524, 0.0003751331595841292, 0.00038503720102049286, 0.0003949412424568569, 0.0004129838193906202, 0.0004375852621765142, 0.00046218670496240904, 0.00048678814774830295, 0.0005113895905341978, 0.0005359910333200919, 0.0005605924761059868, 0.0005851939188918817, 0.0006552838183165425, 0.000783948823374228, 0.001067169503320424, 0.0012013935321321112, 0.0013457043021642856, 0.001507655932915271, 0.0016701152236643865, 0.0018226415685800325, 0.0019771742971838547, 0.002150473285486938, 0.002341286532247916, 0.002544732254155382, 0.002749653842958049, 0.002949632328627883, 0.0031507147137376556, 0.003373816571023657, 0.003621687358271114, 0.003865257276350091, 0.004108484209698728, 0.004349506160937166, 0.004595582355885442, 0.0048650148889875944, 0.0051170306973575075, 0.005357612453386634, 0.005601740206200169, 0.005845453641528734, 0.006087102442646968, 0.006337670990711932, 0.00661234956087943, 0.006914049107090121, 0.007230898618909992, 0.007550250384533789, 0.007865280567636303, 0.008175284812434092, 0.008484321776055731, 0.008801125114390993, 0.009171638387340642, 0.010251596191533334, 0.01147844691789377, 0.012019975684632752, 0.012714546393919952, 0.013219963265535453, 0.013772416640639586, 0.014402765963825602, 0.015073349950791959, 0.01570061485722909, 0.01628808842513287, 0.017134363402610004, 0.01805662983568831, 0.01889898957205961, 0.0197628127340527, 0.02067470689911341, 0.021490072335076143, 0.02230945960401628, 0.023027382851684958, 0.023833347296881507, 0.024522101892506656, 0.025274258314113188, 0.026076462714683713, 0.026625617569378163, 0.02704652806503507, 0.027421247061864825, 0.02774317214271106, 0.02802123497190159, 0.02829126564847276, 0.02857709047148704, 0.02889030001321746, 0.029222668390361615, 0.02960093651076272, 0.03021608162659448, 0.030853574224000573, 0.03132647636118225, 0.03177679022750664, 0.032272544984788445, 0.03274410645285845, 0.03319042705902306, 0.03366054259465282, 0.03414035623956709, 0.03459920137743556, 0.03503036633062648, 0.03545355234628314, 0.03588912144688117, 0.03635283867220026, 0.036832061521376046, 0.03730057841752007, 0.03774476685593918, 0.03817061969117123, 0.038585928614857004, 0.03899618821403804, 0.03940632374411409, 0.03982126815691116, 0.0399361022364217, 0.0399361022364217, 0.0399361022364217, 0.0399361022364217, 0.0399361022364217, 0.0399361022364217, 0.0399361022364217},
.param_8 = {9.855224836455936e-06, 1.0251386493910498e-05, 1.064754815136505e-05, 1.104370980881961e-05, 1.1439871466274156e-05, 1.1836033123728718e-05, 1.223219478118328e-05, 1.2628356438637828e-05, 1.302451809609239e-05, 1.3420679753546935e-05, 1.38168414110015e-05, 1.4213003068456045e-05, 1.4609164725910611e-05, 1.500532638336517e-05, 1.5401488040819716e-05, 1.5797649698274277e-05, 1.6519352775624812e-05, 1.750341048706057e-05, 1.8487468198496365e-05, 1.9471525909932123e-05, 2.0455583621367918e-05, 2.143964133280368e-05, 2.2423699044239474e-05, 2.340775675567527e-05, 2.6211352732661703e-05, 3.1357952934969125e-05, 4.2686780132816966e-05, 4.805574128528446e-05, 5.3828172086571433e-05, 6.030623731661085e-05, 6.680460894657546e-05, 7.290566274320131e-05, 7.90869718873542e-05, 8.601893141947753e-05, 9.365146128991665e-05, 0.0001017892901662153, 0.00010998615371832198, 0.00011798529314511534, 0.00012602858854950626, 0.0001349526628409463, 0.0001448674943308446, 0.00015461029105400366, 0.00016433936838794916, 0.00017398024643748667, 0.0001838232942354177, 0.00019460059555950383, 0.00020468122789430034, 0.0002143044981354654, 0.00022406960824800678, 0.0002338181456611494, 0.00024348409770587876, 0.00025350683962847734, 0.00026449398243517724, 0.0002765619642836049, 0.00028923594475639973, 0.0003020100153813516, 0.00031461122270545224, 0.00032701139249736376, 0.0003393728710422293, 0.0003520450045756398, 0.0003668655354936257, 0.00041006384766133344, 0.00045913787671575087, 0.0004807990273853101, 0.0005085818557567981, 0.0005287985306214181, 0.0005508966656255835, 0.0005761106385530242, 0.0006029339980316784, 0.0006280245942891637, 0.000651523537005315, 0.0006853745361044003, 0.0007222651934275326, 0.0007559595828823846, 0.0007905125093621083, 0.0008269882759645366, 0.0008596028934030459, 0.0008923783841606514, 0.0009210953140673985, 0.0009533338918752605, 0.0009808840757002664, 0.0010109703325645277, 0.0010430585085873486, 0.0010650247027751266, 0.0010818611226014031, 0.0010968498824745932, 0.0011097268857084427, 0.0011208493988760638, 0.0011316506259389106, 0.0011430836188594817, 0.0011556120005286985, 0.0011689067356144647, 0.001184037460430509, 0.0012086432650637794, 0.0012341429689600233, 0.0012530590544472902, 0.0012710716091002658, 0.001290901799391538, 0.0013097642581143382, 0.0013276170823609227, 0.0013464217037861131, 0.001365614249582684, 0.0013839680550974227, 0.0014012146532250593, 0.0014181420938513259, 0.001435564857875247, 0.0014541135468880105, 0.001473282460855042, 0.001492023136700803, 0.0015097906742375675, 0.0015268247876468492, 0.0015434371445942805, 0.0015598475285615219, 0.0015762529497645639, 0.0015928507262764466, 0.0015974440894568685, 0.0015974440894568685, 0.0015974440894568685, 0.0015974440894568685, 0.0015974440894568685, 0.0015974440894568685, 0.0015974440894568685},
.param_9 = {1.7940225897328685},
.param_10 = {183.63619108091584, 80.59605172837969},
.param_11 = {0.3465102385647342, 0.6049663080425999},
.param_12 = {0.16584458332678167},
.name = {'G', 'Y', '0', '5', '1', '0', '2', '3', 'C', '2', '1', '2', '5', '0', '3', '1', '0', 'k'},
