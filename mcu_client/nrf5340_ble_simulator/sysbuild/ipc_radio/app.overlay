/{
       /delete-node/ aliases;
};




/delete-node/ &led0;
/delete-node/ &led1;
/delete-node/ &led2;
/delete-node/ &led3;
/delete-node/ &button0;
/delete-node/ &button1;
/delete-node/ &button2;
/delete-node/ &button3;

&uart0 {
    status = "disabled";
};
