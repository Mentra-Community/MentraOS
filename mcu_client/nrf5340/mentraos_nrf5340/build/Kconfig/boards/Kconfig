## mcu_client/nrf5340/mentraos_nrf5340/build/Kconfig/boards/Kconfig
```kconfig
# Load Zephyr board Kconfig descriptions.
osource "/opt/nordic/ncs/v3.0.0/zephyr/boards/nordic/nrf5340dk/Kconfig"
```

## mcu_client/nrf5340/mentraos_nrf5340/build/mcuboot/Kconfig/boards/Kconfig.nrf5340dk
```kconfig
# Load board Kconfig descriptions.
osource "/opt/nordic/ncs/v3.0.0/zephyr/boards/nordic/nrf5340dk/Kconfig.nrf5340dk"
```

## mcu_client/nrf5340_new_a6m_0011/custom_driver_module/drivers/display/lcd/Kconfig
```kconfig
config CUSTOM_A6M_0011
    bool "A6M_0011 Display Driver"
    default n
    depends on DT_HAS_ZEPHYR_CUSTOM_A6M_0011_ENABLED
    select SPI 
    help
      Driver for A6M_0011 SPI-based display controller.

config CUSTOM_A6M_0011_INIT_PRIORITY
    int "Initialization priority"
    default 60

config CUSTOM_A6M_0011_LOG_LEVEL
    int "Logging level"
    default 3
    range 0 4
```

## mcu_client/peripheral_uart_next/custom_driver_module/drivers/display/lcd/Kconfig
```kconfig
config CUSTOM_HLS12VGA
    bool "Enable custom HLS12VGA driver"
    default n
    depends on DT_HAS_ZEPHYR_CUSTOM_HLS12VGA_ENABLED
    select SPI 
    help
      Driver for HLS12VGA SPI-based display controller.

config CUSTOM_HLS12VGA_INIT_PRIORITY
    int "Initialization priority"
    default 60

config CUSTOM_HLS12VGA_LOG_LEVEL
    int "Logging level"
    default 3
    range 0 4
```

## mcu_client/peripheral_uart_next/custom_driver_module/dts/bindings/display/zephyr,custom-hls12vga.yaml
```yaml
description: HLS12VGA SPI display controller

compatible: "zephyr,custom-hls12vga"

include: [spi-device.yaml, display-controller.yaml]

properties:
  left_cs-gpios:
    type: phandle-array
    required: true
    description: left_cs GPIO pin

  right_cs-gpios:
    type: phandle-array
    required: true
    description: right_cs GPIO pin

  reset-gpios:
    type: phandle-array
    required: true
    description: Reset GPIO pin

  vcom-gpios:
    type: phandle-array
    required: true
    description: vcom GPIO pin

  v1_8-gpios:
    type: phandle-array
    required: true
    description: v1_8 GPIO pin

  v0_9-gpios:
    type: phandle-array
    required: true
    description: v0_9 GPIO pin

  width:
    type: int
    required: true
    description: Display width in pixels
  
  height:
    type: int
    required: true
    description: Display height in pixels
  
```
